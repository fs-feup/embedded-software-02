/*
 * This file is automatically generated based on project contents and settings
 * 
 * Generated: 07/08/2025, 00:13:12
 * 
 */


#constant DEFAULT_ORIENTATION   LANDSCAPE
#constant I_WIDGET_COUNT        0

#CONST
    iGaugeC0
    iLabel0
    iLabel1
    iTextDigits1
    iiTextDigits1
    iTextDigits2
    iiTextDigits2
    iLabel2
    iLabel3
    iGaugeC1
    iLabel4
    iLabel5
    iTextDigits3
    iiTextDigits3
    iLabel6
    iTextDigits4
    iiTextDigits4
    iLedA18
    iPanelA0
    iPanelA1
    iForm3
    iImage2
    iGaugeA0
    iForm4
    iLedA0
    iLedA1
    iLedA2
    iLedA3
    iLedA4
    iLedA5
    iLedA6
    iLedA7
    iLedA8
    iLedA9
    iLedA10
    iLedA11
    iLedA16
    iLedA17
    iLabel7
    iLabel8
    iForm5
    iLedA19
    iLedA20
    iLedA21
    iLedA22
    iLedA23
    iLedA24
    iLedA25
    iLedA26
    iLedA27
    iLedA28
    iLedA29
    iLedA30
    iLedA31
    iLedA32
    iLabel9
    iLabel10
#END

#DATA
    word TextDigits1Info            195, 2, 2, 20, 1, 5, 1, 1
    word TextDigits2Info            244, 2, 2, 20, 1, 5, 1, 1
    word TextDigits3Info            184, 3, 3, 37, 2, 9, 1, 1
    word TextDigits4Info            201, 3, 3, 20, 2, 5, 1, 1
    word Strings0Info               284, 6, 479, 57
    word Strings1Info               0, 4, 202, 55
#END


var hndl;
var ihndl;
var wp;


func SetupMedia()
    while(!file_Mount())
        putstr("Drive not mounted...");
        pause(200);
        gfx_Cls();
        pause(200);
    wend
    hndl := file_LoadImageControl("daSh.dat", "daSh.gci", 1);
endfunc

